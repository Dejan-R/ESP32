## 00_ESP32_Project_Structure/components/hello_lib/Kconfig
```kconfig
menu "Hello component configuration"

config ENABLE_HELLO
    bool "Enable Hello message"
    default y
    help
        Ako je uključeno, prikazuje se 'Hello from component!'

endmenu
```

## 00_ESP32_Project_Structure/sdkconfig.defaults
```kconfig
CONFIG_LOG_DEFAULT_LEVEL_INFO=y
CONFIG_FREERTOS_HZ=100
CONFIG_FREERTOS_THREAD_LOCAL_STORAGE_POINTERS=2
```
